#define LLE 1<<PH6
#define CLK 1<<PH5
#define SDI 1<<PH4
#define PORT_SHIFT PORTH
void pinWrite( unsigned int bit, unsigned int val );
void pulseClock ( void );
void shiftOut(unsigned int val);

/* hàng và cột của LED matrix*/
int row[] = {254, 253, 251,247, 239, 223, 191, 127};
int column[] = {128, 64, 32, 16, 8, 4, 2, 1};
/*biểu diễn các ký tự chữ và số ở dạng HEX*/
unsigned int characterHEX[][8] = {
{0x18,0x3C,0x66,0x66,0x7E,0x66,0x66,0x66},//A
{0x78,0x64,0x68,0x78,0x64,0x66,0x66,0x7C},//B
{0x3C,0x62,0x60,0x60,0x60,0x62,0x62,0x3C},//C
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{0x00,0x66,0xFF,0xFF,0x7E,0x3C,0x18,0x00}// hình trái tim, kí hiệu là '&'
};
/* ký tự đại diện để biểu diễn chữ và số trên matrix*/
char character[] = {'A','B','C','D','E','F','G','H','I','J','K','L','M','N','O','P','Q','R','S','T','U','V','W','X','Y','Z','0','1','2','3','4','5','6','7','8','9',' ','&'};


void setup() {
  // put your setup code here, to run once:
DDRH=(0<<DDH7) | (1<<DDH6) | (1<<DDH5) | (1<<DDH4) | (0<<DDH3) | (0<<DDH2) | (0<<DDH1) | (0<<DDH0);
// State: Bit7=1 Bit6=1 Bit5=1 Bit4=T Bit3=T Bit2=T Bit1=T Bit0=T 
PORTH=(0<<PORTH7) | (1<<PORTH6) | (1<<PORTH5) | (1<<PORTH4) | (0<<PORTH3) | (0<<PORTH2) | (0<<PORTH1) | (0<<PORTH0);

DDRB=(1<<DDB7) | (1<<DDB6) | (1<<DDB5) | (1<<DDB4) | (1<<DDB3) | (1<<DDB2) | (1<<DDB1) | (1<<DDB0);
// State: Bit7=1 Bit6=1 Bit5=1 Bit4=T Bit3=T Bit2=T Bit1=T Bit0=T 
PORTB=(1<<PORTB7) | (1<<PORTB6) | (1<<PORTB5) | (1<<PORTB4) | (1<<PORTB3) | (1<<PORTB2) | (1<<PORTB1) | (1<<PORTB0);
}

void loop() {
  // put your main code here, to run repeatedly:
 /* PORTB=0x01;
  for(int i=0;i<16;i++)
  {
  shiftOut(1<<i);
  delay(100);
  }*/
  //blinkImage(characterHEX[1],1,30,30);
  scrollImage(characterHEX[26]);
}
void pinWrite( unsigned int bit, unsigned int val )
{
  if (val){
    PORT_SHIFT |= bit;
  } else {
    PORT_SHIFT &= ~bit;
  }
}
void pulseClock( void )
{
  PORT_SHIFT |= CLK;
  PORT_SHIFT &= ~CLK;

}
void shiftOut(unsigned int val)
{
  //Set LLE to low (should be already)
  PORT_SHIFT &= ~LLE;

  char i;

  // Iterate over each bit, set SDI pin, and pulse the clock to send it
  // to the shift register
  for (i = 0; i < 16; i++)  {
      pinWrite(SDI, (val & (1 << i)));
      pulseClock();
  }
  // Pulse the LLE pin to write the values into the storage register
  PORT_SHIFT |= LLE;
  PORT_SHIFT &= ~LLE;
}

/* hàm nhấp nháy chữ*/
/* image là ký tự cần hiển thị,
   times là số lần nhấp nháy,
   on, off là độ dài của hiệu ứng*/
void blinkImage(unsigned int image[],int times,int on,int off)
{
  for(int i=0;i<times;i++)
  {
    displayImage(image,on);// hiển thị
    
    clearImage(off);// xóa  
  }
}
/*hàm hiển thị chữ lên LED matrix*/
/* image là ký tự cần hiển thị,
   duration là độ dài của hiệu ứng*/
void displayImage(unsigned int image[],int duration)
{
  for(int hold=0;hold<duration;hold++)
  {
    for(int a=0;a<8;a++)
    {
      uint16_t temp=0;
      temp=~image[a];
      temp=temp<<8|0xff;
      shiftOut(~temp);
      PORTB=row[a];
    }
  }
}
/* hàm clear LED matrix*/
/* duration là độ dài của hiệu ứng clear*/
void clearImage(int duration)
{
  for(int hold=0;hold<duration;hold++)
  {
    for(int a=0;a<8;a++)
    {
      shiftOut(~(0xffff));
      PORTB=row[a];
      delay(1);
    }
  }
}
/*hàm scroll image sang trái*/
/* image là ký tự cần hiển thị*/

void scrollImage(unsigned int image[])
{
  int shift, hold, a;//biến shift dùng để lưu số bit cần shiftOut
                     //biến hold dùng để điều chỉnh độ dài của hiệu ứng
                     //biến a dùng để lưu column và row hiện tại
  for(shift = 0; shift < 9; shift++)
  {
    for(hold = 0; hold < 30; hold++)
    {
      for(a = 0; a < 8; a++)
      {
         uint16_t temp=0;
      temp=~(image[a]<<shift);
      temp=temp<<8|0xff;
      shiftOut(~temp);
      PORTB=row[a];
        
        delay(1);
      }
    }
  }
  
}
